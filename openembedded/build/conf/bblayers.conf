## openembedded/build/conf/bblayers.conf
```bitbake
# LAYER_CONF_VERSION is increased each time build/conf/bblayers.conf
# changes incompatibly
LCONF_VERSION = "6"

BBPATH = "${TOPDIR}"
BBFILES ?= ""

BBLAYERS ?= " \
  /home/jeff/hg/openembedded/meta \
  /home/jeff/hg/openembedded/meta-yocto \
  /home/jeff/hg/openembedded/meta-yocto-bsp \
  /home/jeff/hg/openembedded/meta-openembedded/meta-oe \
  /home/jeff/hg/openembedded/meta-openembedded/meta-networking \
  /home/jeff/hg/openembedded/meta-openembedded/meta-python \
  /home/jeff/hg/openembedded/meta-powermeter \
  "
BBLAYERS_NON_REMOVABLE ?= " \
  /home/jeff/hg/openembedded/meta \
  /home/jeff/hg/openembedded/meta-yocto \
  "
```

## openembedded/meta-powermeter/conf/layer.conf
```bitbake
# We have a conf and classes directory, add to BBPATH
BBPATH .= ":${LAYERDIR}"

# We have recipes-* directories, add to BBFILES
BBFILES += "${LAYERDIR}/recipes-*/*/*.bb \
	${LAYERDIR}/recipes-*/*/*.bbappend"

BBFILE_COLLECTIONS += "powermeter"
BBFILE_PATTERN_powermeter = "^${LAYERDIR}/"
BBFILE_PRIORITY_powermeter = "6"
```
